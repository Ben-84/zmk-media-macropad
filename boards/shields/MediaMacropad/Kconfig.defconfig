## boards/shields/MediaMacropad/Kconfig.defconfig
```kconfig
if SHIELD_MEDIAMACROPAD

config ZMK_KEYBOARD_NAME
	default "MediaMacropad"
	
endif
```

## boards/shields/media_macropad/Kconfig.defconfig
```kconfig
if SHIELD_MEDIAMACROPAD

config ZMK_KEYBOARD_NAME
	default "Media Macropad"
endif
```

## boards/shields/media_macropad/Kconfig.shield
```kconfig
config SHIELD_MEDIAMACROPAD
	def_bool $(shields_list_contains, MediaMacropad)
	
CONFIG_EC11=y
CONFIG_EC11_TRIGGER_GLOBAL_THREAD=y
```
