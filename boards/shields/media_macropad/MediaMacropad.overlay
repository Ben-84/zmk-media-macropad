/ {
	chosen {
		zmk,kscan = &default_kscan;		
	};

	default_kscan: kscan {
		compatible = "zmk,kscan-gpio-direct";
		label = "default_kscan";
		
		input-gpios =
			<&pro_micro 0 (GPIO_ACTIVE_HIGH | GPIO_PULL_DOWN)>,
			<&pro_micro 3 (GPIO_ACTIVE_HIGH | GPIO_PULL_DOWN)>,
			<&pro_micro 21 (GPIO_ACTIVE_HIGH | GPIO_PULL_DOWN)>,
			<&pro_micro 19 (GPIO_ACTIVE_HIGH | GPIO_PULL_DOWN)>,
			<&pro_micro 15 (GPIO_ACTIVE_HIGH | GPIO_PULL_DOWN)>,
			<&pro_micro 16 (GPIO_ACTIVE_HIGH | GPIO_PULL_DOWN)>;
	};
	
//	encoder: encoder {
//		compatible = "alps,ec11";
//		a-gpios = <&pro_micro 1 (GPIO_ACTIVE_HIGH | GPIO_PULL_UP)>;
//		b-gpios = <&pro_micro 0 (GPIO_ACTIVE_HIGH | GPIO_PULL_UP)>;
//		steps = <80>;
//		status = "okay";
 //};
	
//	sensors: sensors {
//		compatible = "zmk,keymap-sensors";
//      sensors = <&encoder>;
//		triggers-per-rotation = <20>;
//	};
};